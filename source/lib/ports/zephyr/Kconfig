## source/lib/ports/zephyr/Kconfig
```kconfig
#----------------------------------------------------------------------------
#  SPDX-FileCopyrightText: Copyright 2025 Arm Limited and/or its
#  affiliates <open-source-office@arm.com>
#  SPDX-License-Identifier: Apache-2.0
#
#  Licensed under the Apache License, Version 2.0 (the "License");
#  you may not use this file except in compliance with the License.
#  You may obtain a copy of the License at
#
#      http://www.apache.org/licenses/LICENSE-2.0
#
#  Unless required by applicable law or agreed to in writing, software
#  distributed under the License is distributed on an "AS IS" BASIS,
#  WITHOUT WARRANTIES OR CONDITIONS OF ANY KIND, either express or implied.
#  See the License for the specific language governing permissions and
#  limitations under the License.
#----------------------------------------------------------------------------
config MLEK_EXAMPLES_LIB
    bool "Add Arm MLEK examples library"
    default n
    help
        Include ML Embedded Evaluation Kit examples library.

if MLEK_EXAMPLES_LIB
    choice MLEK_EXAMPLES_FRAMEWORK
        bool "Machine learning framework to use with MLEK examples"
        default MLEK_EXAMPLES_FWK_TFLM

        config MLEK_EXAMPLES_FWK_TFLM
            bool "MLEK with TensorFlow Lite Micro framework"
            depends on TENSORFLOW_LITE_MICRO && CMSIS_DSP
            help
                Enable Arm MLEK examples to use TensorFlow Lite Micro framework.

        config MLEK_EXAMPLES_FWK_EXECUTORCH
            bool "MLEK with ExecuTorch framework"
            depends on EXECUTORCH && CMSIS_DSP
            help
                Enable Arm MLEK examples to use ExecuTorch framework.
    endchoice # MLEK_EXAMPLES_FRAMEWORK

    config MLEK_EXAMPLES_LOG_ENABLE
        bool "Arm MLEK logging"
        default n
        help
            Enable logging for Arm MLEK libraries and examples.

    if MLEK_EXAMPLES_LOG_ENABLE
        choice MLEK_EXAMPLES_LOG_LEVEL
            bool "MLEK log level choice"
            default MLEK_EXAMPLES_LOG_LEVEL_INFO

            config MLEK_EXAMPLES_LOG_LEVEL_TRACE
                bool "Trace"

            config MLEK_EXAMPLES_LOG_LEVEL_DEBUG
                bool "Debug"

            config MLEK_EXAMPLES_LOG_LEVEL_INFO
                bool "Info"

            config MLEK_EXAMPLES_LOG_LEVEL_WARN
                bool "Warn"

            config MLEK_EXAMPLES_LOG_LEVEL_ERROR
                bool "Error"
        endchoice # MLEK_EXAMPLES_LOG_LEVEL
    endif # MLEK_EXAMPLES_LOG_ENABLE
endif # MLEK_EXAMPLES_LIB
```
